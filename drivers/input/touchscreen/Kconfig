## drivers/input/touchscreen/Kconfig
```kconfig
#
# Touchscreen driver configuration
#

menuconfig TOUCHSCREEN_MTK
	bool "Touchscreens"
	help
	  Say Y here, and a list of supported touchscreens will be displayed.
	  This option doesn't affect the kernel.

	  If unsure, say Y.

if TOUCHSCREEN_MTK


endif # MESON_INPUT_TOUCHSCREEN
```

## drivers/misc/mediatek/alsps/ap3426/Kconfig
```kconfig
config MTK_AP3426
	bool "ap3426 for MediaTek package"
	default n
	help
	It support different type sensor
	in this platform. If this option
	is set, it will support ambient
	and light sensor ap3426.
```

## drivers/misc/mediatek/flashlight/Kconfig
```kconfig
config MTK_FLASHLIGHT
  bool CONFIG_MTK_FLASHLIGHT
  default n
  help
    CONFIG_MTK_FLASHLIGHT

config CUSTOM_KERNEL_FLASHLIGHT
        string "CUSTOM_KERNEL_FLASHLIGHT"
        help
          Kernel space cameara flashlight driver. You can use this driver
          choose cameara flashlight type.

config MTK_FLASHLIGHT_USE_MODULE
	bool "Mediatek flashlight driver build as module"
	default n
	help
	  Say Y here if you want to build flashlight driver as xxx.ko.

	  If unsure, say N.

	  To compile this dirver as a module,
	  It will be called by insmod xxx.ko in init.rc.


config MTK_FLASHLIGHT_ALLOW_ON_LOW_POWER
	bool "Allow flashlight operation when the battery is low (i.e. < 15%)"
	default n
	help
	  Say Y here if you want to allow flashlight on low power modes.
```
