cust_alsps@0 {
		compatible = "mediatek,cm36652";
		i2c_num = <0x2>;
		i2c_addr = <0x60 0x0 0x0 0x0>;
		polling_mode_ps = <0x0>;
		polling_mode_als = <0x1>;
		power_id = <0xffff>;
		power_vol = <0x0>;
		als_level = <0x0 0x148 0x35d 0x561 0xc35 0x1e29 0x1e57 0x314d 0x5a16 0x6f0e 0x81fa 0xb80c 0xe15e 0xe15e 0xffff>;
		als_value = <0x0 0x85 0x130 0x1f6 0x3ec 0x7d5 0xbf2 0x138d 0x1f48 0x271a 0x2ee0 0x3e80 0x4e20 0x4e20 0x4e20 0x4e20>;
		ps_threshold_high = <0x22>;
		ps_threshold_low = <0x1c>;
		is_batch_supported_ps = <0x0>;
		is_batch_supported_als = <0x0>;
	};
cust_alsps@1 {
		compatible = "mediatek,ap3426";
		i2c_num = <0x2>;
		i2c_addr = <0x3c 0x38 0x3a 0x0>;
		polling_mode_ps = <0x0>;
		polling_mode_als = <0x1>;
		power_id = <0xffff>;
		power_vol = <0x0>;
		als_level = <0x0 0x9 0xb 0xc 0xf 0x14 0x19 0x1b 0x1e 0x28 0x2d 0x32 0x64 0x12c 0x258 0x3e8 0x578 0x708 0x7d0>;
		als_value = <0x0 0xa 0xf 0x32 0x64 0xc8 0x12c 0x1f4 0x28a 0x384 0x3b6 0x3f2 0x500 0x500 0xa28 0xa28 0xa28 0x2800 0x2800>;
		ps_threshold_high = <0x130 0xff 0x40 0x10>;
		ps_threshold_low = <0x45 0x61 0x10 0x1>;
		is_batch_supported_ps = <0x0>;
		is_batch_supported_als = <0x0>;
	};

cust_alsps@2 {
		compatible = "mediatek,em3071x";
		i2c_num = <0x2>;
		i2c_addr = <0x48 0x0 0x0 0x0>;
		polling_mode_ps = <0x0>;
		polling_mode_als = <0x1>;
		power_id = <0xffff>;
		power_vol = <0x0>;
		als_level = <0x7 0x2b 0x51 0x7a 0xc0 0x10c 0x1c9 0x240 0x2e1 0x3a1 0x4dd 0x5e2 0x92d 0xc5e 0x154a 0x2605 0x283f 0x3462>;
		als_value = <0x5 0x1e 0x3c 0x5a 0x96 0xc8 0x15e 0x1c2 0x226 0x2d0 0x3b6 0x44c 0x5dc 0x7d0 0xdac 0x15e0 0x1a2c 0x21fc 0x2710>;
		ps_threshold_high = <0x31 0x41 0x50 0x60>;
		ps_threshold_low = <0x2d 0x21 0x30 0x41>;
		is_batch_supported_ps = <0x0>;
		is_batch_supported_als = <0x0>;
	};
