	cust_gyro@0 {
		compatible = "mediatek,itg1010";
		i2c_num = <0x2>;
		i2c_addr = <0x68 0x0 0x0 0x0>;
		direction = <0x3>;
		power_id = <0xffff>;
		power_vol = <0x0>;
		firlen = <0x0>;
		is_batch_supported = <0x0>;
	};

	cust_gyro@1 {
		compatible = "mediatek,icm206xx_gyro";
		i2c_num = <0x2>;
		i2c_addr = <0x68 0x0 0x0 0x0>;
		direction = <0x2>;
		power_id = <0xffff>;
		power_vol = <0x0>;
		firlen = <0x0>;
		is_batch_supported = <0x0>;
	};
