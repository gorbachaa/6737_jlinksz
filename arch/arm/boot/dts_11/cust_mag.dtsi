	cust_mag@0 {
		compatible = "mediatek,akm09911";
		i2c_num = <0x2>;
		i2c_addr = <0xd 0x0 0x0 0x0>;
		direction = <0x1>;
		power_id = <0xffff>;
		power_vol = <0x0>;
		is_batch_supported = <0x0>;
	};

	cust_mag@1 {
		compatible = "mediatek,qmcX983";
		i2c_num = <0x2>;
		i2c_addr = <0x2c 0x0 0x0 0x0>;
		direction = <0x6>;
		power_id = <0xffff>;
		power_vol = <0x0>;
		is_batch_supported = <0x0>;
	};
